# file: F407_MULTI_ADC.ioc
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Mcu.Family=STM32F4
Mcu.Name=STM32F407V(E-G)Tx
Mcu.Package=LQFP100
NVIC.PriorityGroup=NVIC_PRIORITYGROUP_4
PA13.Mode=Serial_Wire
PA13.Signal=SYS_JTMS-SWDIO
PA14.Mode=Serial_Wire
PA14.Signal=SYS_JTCK-SWCLK
PH0-OSC_IN.Mode=HSE-External-Oscillator
PH0-OSC_IN.Signal=RCC_OSC_IN
PH1-OSC_OUT.Mode=HSE-External-Oscillator
PH1-OSC_OUT.Signal=RCC_OSC_OUT
ProjectManager.HeapSize=0x200
ProjectManager.StackSize=0x400
ProjectManager.TargetToolchain=STM32CubeIDE
RCC.48MHZClocksFreq_Value=84000000
RCC.AHBFreq_Value=168000000
RCC.APB1CLKDivider=RCC_HCLK_DIV4
RCC.APB1Freq_Value=42000000
RCC.APB1TimFreq_Value=84000000
RCC.APB2CLKDivider=RCC_HCLK_DIV2
RCC.APB2Freq_Value=84000000
RCC.APB2TimFreq_Value=168000000
RCC.CortexFreq_Value=168000000
RCC.HCLKFreq_Value=168000000
RCC.HSE_VALUE=8000000
RCC.HSI_VALUE=16000000
RCC.LSE_VALUE=32768
RCC.PLLM=4
RCC.PLLN=168
RCC.PLLSourceVirtual=RCC_PLLSOURCE_HSE
RCC.SYSCLKFreq_VALUE=168000000
RCC.SYSCLKSource=RCC_SYSCLKSOURCE_PLLCLK
RCC.VCOOutputFreq_Value=336000000
board=custom

// file: Core/Src/main.c
/* USER CODE BEGIN Header */
/**
  ******************************************************************************
  * @file           : main.c
  * @brief          : Main program body
  ******************************************************************************
  * @attention
  *
  * Copyright (c) 2025 STMicroelectronics.
  * All rights reserved.
  *
  * This software is licensed under terms that can be found in the LICENSE file
  * in the root directory of this software component.
  * If no LICENSE file comes with this software, it is provided AS-IS.
  *
  ******************************************************************************
  */
/* USER CODE END Header */
#include "main.h"

/* USER CODE BEGIN PV */
uint16_t adcvalue0=0;
uint16_t adcvalue1=0;
uint8_t ledbrightness0=0;
uint8_t ledbrightness1=0;
/* USER CODE END PV */

void SystemClock_Config(void);
static void MX_GPIO_Init(void);
/* USER CODE BEGIN PFP */
void GpioConfig(void);
void AdcConfig(void);
uint16_t Read_Adc(uint8_t channel);
uint8_t map(uint16_t adcValue,uint16_t AdcMax,uint16_t AdcMin,uint16_t OutMax,uint16_t OutMin);
/* USER CODE END PFP */

/* USER CODE BEGIN 0 */
//pa0,pa1 adc pd12,13,14,15 led
void GpioConfig(void)
{
	RCC->AHB1ENR |=0x00000009;

	GPIOA->MODER |=0x0000000F;

	GPIOD->MODER |=0x00000055;
	GPIOD->OTYPER&=~(0x0000000F);
	GPIOD->OSPEEDR|=0x000000FF;
	GPIOD->PUPDR&=~(0x000000FF);
}
void AdcConfig(void)
{
	RCC->APB2ENR |=0x00000100;
	ADC1->SR |=0x00000010;
	ADC1->CR1&=~(0x03000000);
	ADC1->CR1 |=0x00000100;
	ADC1->CR2 |=0x00000003;
	ADC1->SMPR2 |=0x0000001B;
    ADC1->SQR1 &= ~0x00F00000; // Toplam sıradaki kanal sayısı = 2 (L[3:0] = 1)
    ADC1->SQR3 |= (0 << 0);    // 1. sıradaki kanal: Kanal 0
    ADC1->SQR3 |= (1 << 5);    // 2. sıradaki kanal: Kanal 1
    ADC->CCR   |=0x00030000;
}
uint16_t Read_Adc(uint8_t channel)
{
	ADC1->SQR3 = channel;
	ADC1->CR2 |= 0x40000000;
    while (!(ADC1->SR & 0x00000002));
    return (uint16_t)ADC1->DR;
}
uint8_t map(uint16_t adcValue,uint16_t AdcMax,uint16_t AdcMin,uint16_t OutMax,uint16_t OutMin)
{
	return (uint8_t)((((adcValue - AdcMin) * (OutMax - OutMin)) / (AdcMax - AdcMin)) + OutMin);
}
/* USER CODE END 0 */

int main(void)
{

  /* MCU Configuration--------------------------------------------------------*/

  /* Reset of all peripherals, Initializes the Flash interface and the Systick. */
  HAL_Init();

  /* Configure the system clock */
  SystemClock_Config();

  /* Initialize all configured peripherals */
  MX_GPIO_Init();
  /* USER CODE BEGIN 2 */
  GpioConfig();
  AdcConfig();

  /* USER CODE END 2 */

  /* Infinite loop */
  while (1)
  {

    /* USER CODE BEGIN 3 */
	  adcvalue0=Read_Adc(0);
	  ledbrightness0=map(adcvalue0, 4095, 0, 255, 0);

	  adcvalue1=Read_Adc(1);
	  ledbrightness1=map(adcvalue0, 4095, 0, 255, 0);

	  if(ledbrightness0>128)
	  {
		  GPIOD->ODR |=0x00003000;
	  }
	  if(ledbrightness1>128)
	  {
		  GPIOD->ODR |=0x0000C000;
	  }
  }
  /* USER CODE END 3 */
}

void SystemClock_Config(void)
{
  RCC_OscInitTypeDef RCC_OscInitStruct = {0};
  RCC_ClkInitTypeDef RCC_ClkInitStruct = {0};

  /** Configure the main internal regulator output voltage
  */
  __HAL_RCC_PWR_CLK_ENABLE();
  __HAL_PWR_VOLTAGESCALING_CONFIG(PWR_REGULATOR_VOLTAGE_SCALE1);

  /** Initializes the RCC Oscillators according to the specified parameters
  * in the RCC_OscInitTypeDef structure.
  */
  RCC_OscInitStruct.OscillatorType = RCC_OSCILLATORTYPE_HSE;
  RCC_OscInitStruct.HSEState = RCC_HSE_ON;
  RCC_OscInitStruct.PLL.PLLState = RCC_PLL_ON;
  RCC_OscInitStruct.PLL.PLLSource = RCC_PLLSOURCE_HSE;
  RCC_OscInitStruct.PLL.PLLM = 4;
  RCC_OscInitStruct.PLL.PLLN = 168;
  RCC_OscInitStruct.PLL.PLLP = RCC_PLLP_DIV2;
  RCC_OscInitStruct.PLL.PLLQ = 4;
  if (HAL_RCC_OscConfig(&RCC_OscInitStruct) != HAL_OK)
  {
    Error_Handler();
  }

  /** Initializes the CPU, AHB and APB buses clocks
  */
  RCC_ClkInitStruct.ClockType = RCC_CLOCKTYPE_HCLK|RCC_CLOCKTYPE_SYSCLK
                              |RCC_CLOCKTYPE_PCLK1|RCC_CLOCKTYPE_PCLK2;
  RCC_ClkInitStruct.SYSCLKSource = RCC_SYSCLKSOURCE_PLLCLK;
  RCC_ClkInitStruct.AHBCLKDivider = RCC_SYSCLK_DIV1;
  RCC_ClkInitStruct.APB1CLKDivider = RCC_HCLK_DIV4;
  RCC_ClkInitStruct.APB2CLKDivider = RCC_HCLK_DIV2;

  if (HAL_RCC_ClockConfig(&RCC_ClkInitStruct, FLASH_LATENCY_5) != HAL_OK)
  {
    Error_Handler();
  }
}

static void MX_GPIO_Init(void)
{

  /* GPIO Ports Clock Enable */
  __HAL_RCC_GPIOH_CLK_ENABLE();
  __HAL_RCC_GPIOA_CLK_ENABLE();

}

void Error_Handler(void)
{
  __disable_irq();
  while (1)
  {
  }
}
